## Kconfig
```kconfig
comment "Example Project Configuration"

# Add as many dependencies as this BSP requires. I.e. MUST haves for this board.
# E.g. select SHELL etc.

config PROJECT_DEPENDENCIES
           bool
           default      y
           select       SHELL
```

## bsp/Kconfig
```kconfig
comment "Example BSP options"

config BSP_DIR
           string
           default "../bsp/"

config BSP_NAME
           string
           default "Example"
```
